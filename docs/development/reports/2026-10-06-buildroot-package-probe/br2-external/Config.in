## docs/development/reports/2026-10-06-buildroot-package-probe/br2-external/Config.in
```kconfig
source "$BR2_EXTERNAL_PICDPLAYER_PROBE_PATH/package/libdiscid/Config.in"
source "$BR2_EXTERNAL_PICDPLAYER_PROBE_PATH/package/picdplayer/Config.in"
```

## docs/development/reports/2026-10-06-buildroot-package-probe/br2-external/package/libdiscid/Config.in
```kconfig
config BR2_PACKAGE_LIBDISCID
	bool "libdiscid"
	depends on !BR2_STATIC_LIBS
	help
	  MusicBrainz Disc ID library for audio CDs.

	  https://github.com/metabrainz/libdiscid
```

## docs/development/reports/2026-10-06-buildroot-package-probe/br2-external/package/picdplayer/Config.in
```kconfig
config BR2_PACKAGE_PICDPLAYER
	bool "picdplayer (feasibility probe)"
	depends on BR2_INSTALL_LIBSTDCPP
	depends on BR2_PACKAGE_ALSA_LIB
	depends on BR2_PACKAGE_LIBCURL_OPENSSL
	depends on BR2_PACKAGE_LIBDISCID
	depends on BR2_PACKAGE_LIBWEBSOCKETS
	depends on BR2_PACKAGE_JSON_FOR_MODERN_CPP
	help
	  PiCDPlayer Buildroot package feasibility probe.
```
